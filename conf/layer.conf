## conf/layer.conf
```bitbake
BBPATH .= ":${LAYERDIR}"

BBFILES += "${LAYERDIR}/recipes-*/*/*.bb \
            ${LAYERDIR}/recipes-*/*/*.bbappend"

BBFILE_COLLECTIONS += "dasharo"
BBFILE_PATTERN_dasharo = "^${LAYERDIR}/"
BBFILE_PRIORITY_dasharo = "80"

LAYERVERSION_dasharo = "1"

LAYERSERIES_COMPAT_dasharo = "scarthgap master"

# See this comment:
# https://github.com/Dasharo/meta-dasharo/pull/7#issuecomment-3052659291
PREFERRED_VERSION_converged-security-suite = "2.6.0"
```
